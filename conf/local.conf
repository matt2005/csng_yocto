## conf/local.conf
```bitbake
# Local configuration for meta-rpi images
# Yocto Project 3.1 Poky distribution [dunfell] branch
# This is a sysvinit system

# mask wireguard from meta-openembedded/meta-networking
# use version in meta-jumpnow to support kernels < 5.6
# with wireguard-linux-compat
BBMASK = "meta-networking/recipes-kernel/wireguard"

LICENSE_FLAGS_WHITELIST = "commercial"

DISTRO_FEATURES = "x11 ext2 opengl usbhost ${DISTRO_FEATURES_LIBC}"

DISTRO_FEATURES_BACKFILL_CONSIDERED += "pulseaudio"

PREFERRED_PROVIDER_jpeg = "libjpeg-turbo"
PREFERRED_PROVIDER_jpeg-native = "libjpeg-turbo-native"

PREFERRED_PROVIDER_udev = "eudev"
VIRTUAL-RUNTIME_init_manager = "sysvinit"

MACHINE_FEATURES_remove = "apm"

IMAGE_FSTYPES = "tar.xz rpi-sdimg"

# Choose the board you are building for
#MACHINE = "raspberrypi"
#MACHINE = "raspberrypi0"
#MACHINE = "raspberrypi0-wifi"
#MACHINE = "raspberrypi2"
#MACHINE = "raspberrypi3"
#MACHINE = "raspberrypi4"
#MACHINE = "raspberrypi-cm"
#MACHINE = "raspberrypi-cm3"

# Choices are Image or zImage if NOT using u-boot (no u-boot is the default)
# Choices are uImage or zImage if using u-boot, though if you choose zImage
# with u-boot you will also have to change the boot script boot command
KERNEL_IMAGETYPE = "zImage"

# uncomment for kernels < 5.6
WIREGUARD_COMPAT = "1"

DISABLE_VC4GRAPHICS = "1"
DISABLE_OVERSCAN = "1"
ENABLE_UART = "1"
ENABLE_RPI3_SERIAL_CONSOLE = "1"
SERIAL_CONSOLES = "115200;ttyAMA0"
# SERIAL_CONSOLES_forcevariable = ""

# default is still 4.19, uncomment the following for 5.4
# PREFERRED_VERSION_linux-raspberrypi = "5.4.%"


# DL_DIR = "/src/oe"
# SSTATE_DIR = "/oe6/rpi/sstate-cache"
# TMPDIR = "/oe6/rpi/tmp-dunfell"

DISTRO = "poky"
PACKAGE_CLASSES = "package_ipk"

# i686 or x86_64
SDKMACHINE = "x86_64"

# for no root passwd uncomment the following and comment the two extra user lines
#EXTRA_IMAGE_FEATURES = "debug-tweaks"

# for a root passwd, change jumpnowtek below to your password
INHERIT += "extrausers"
EXTRA_USERS_PARAMS = "usermod -P jumpnowtek root; "

# this will force root to change password on first login
INHERIT += "chageusers"
CHAGE_USERS_PARAMS = "chage -d0 root; "

USER_CLASSES = "image-mklibs image-prelink"
PATCHRESOLVE = "noop"
RM_OLD_IMAGE = "1"
INHERIT += "rm_work"
CONF_VERSION = "1"

# speed up build, value to double cpu count
BB_NUMBER_PARSE_THREADS = "8"
BB_NUMBER_THREADS = "8"
#PARALLEL_MAKE = "4"
#PARALLEL_MAKEINST = "4"

# IVI Additions

### Qt ### 
IMAGE_INSTALL_append = " make cmake"
IMAGE_INSTALL_append = " qtbase-tools qtbase qtdeclarative qtimageformats qtmultimedia qtquickcontrols2 qtquickcontrols qtbase-plugins cinematicexperience liberation-fonts"
PACKAGECONFIG_FONTS_append_pn-qtbase = " fontconfig"

### Network support ### 
IMAGE_INSTALL_append = " openssh-sftp-server rsync"

### Sound ###
IMAGE_INSTALL_append = " gstreamer1.0-plugins-good gstreamer1.0-plugins-base gstreamer1.0-plugins-ugly"
LICENSE_FLAGS_WHITELIST_append = " commercial  commercial_gstreamer1.0-plugins-ugly commercial_gstreamer1.0-plugins-ugly"
PACKAGECONFIG_append_pn-qtmultimedia = " gstreamer alsa"

### Audio Streaming ###
DISTRO_FEATURES_append = " pulseaudio"
IMAGE_INSTALL_append = " pulseaudio pulseaudio-module-dbus-protocol pulseaudio-server pulseaudio-module-bluetooth-discover pulseaudio-module-bluetooth-policy pulseaudio-module-bluez5-device pulseaudio-module-bluez5-discover alsa-utils alsa-plugins"

### Video ###
HDMI_GROUP = "1"
HDMI_MODE = "4"

### Bluetooth  ###
MACHINE_FEATURES += " bluetooth"
CORE_IMAGE_EXTRA_INSTALL = " rsync "
DISTRO_FEATURES_append = " pi-bluetooth bluez5 bluetooth linux-firmware-bcm43430 linux-firmware-brcmfmac43430"
IMAGE_INSTALL_append = " pi-bluetooth bluez5 bluez5-testtools linux-firmware-bcm43430 i2c-tools hostapd dhcp-server udev-rules-rpi bridge-utils iptables linux-firmware-ralink linux-firmware-rtl8192ce linux-firmware-rtl8192cu linux-firmware-rtl8192su linux-firmware-rpidistro-bcm43430"
ENABLE_UART = "1"

### Debugging ###

IMAGE_INSTALL_append = " strace"
EXTRA_IMAGE_FEATURES += "tools-debug"
```
